## Kconfig.nxp
```kconfig
# Copyright 2024 NXP

# SPDX-License-Identifier: Apache-2.0
# Top level Kconfig file for out of tree ZSDK

rsource "drivers/Kconfig"
```

## modules/nxp-openthread-vendor/Kconfig
```kconfig
# SPDX-License-Identifier: Apache-2.0

config SHELL_NXP_VENDOR_COMMANDS_EXTENSION
bool "NXP Vendor Commands for OpenThread Shell (Extension-based)"
default y
depends on OPENTHREAD_SHELL
help
	Enable NXP vendor-specific commands for OpenThread CLI using
	the official OpenThread Extension mechanism (no Zephyr patch required).

	Provides commands:
	- ot radio_nxp <subcommand>
	- ot seteui64 <eui64>
	- ot txpwrlimit [<limit> [enableRFCH26Clamp|disableRFCH26Clamp]]

if SHELL_NXP_VENDOR_COMMANDS_EXTENSION

config NXP_VENDOR_COMMANDS_LOG_LEVEL
int "NXP Vendor Commands Log Level"
default 3
range 0 4
help
	Set the log level for NXP vendor commands module.
	0 = OFF, 1 = ERR, 2 = WRN, 3 = INF, 4 = DBG

endif # SHELL_NXP_VENDOR_COMMANDS_EXTENSION
```

## samples/wireless/coex/tester/Kconfig
```kconfig
# Config options for tester app

# Copyright (c) 2025 NXP
# Copyright (c) 2023 Codecoup
# SPDX-License-Identifier: Apache-2.0

menu "Bttester configuration"

module = BTTESTER
module-str = bttester
source "subsys/logging/Kconfig.template.log_config"

config BTTESTER_BTP_CMD_THREAD_STACK_SIZE
	int "BTP CMD threads stack size."
	default 2048
	help
	  Stack size in byte used by the BTP CMD thread.

endmenu

# Config options for prerequisites mbedtls PSA
config COEX_MBEDTLS_PSA
	bool "mbed TLS PSA built-in"
	select PSA_WANT_ALG_ECDSA if OPENTHREAD_ECDSA
	select PSA_WANT_ALG_JPAKE
	select PSA_WANT_ALG_GCM
	help
	  Use the mbed TLS PSA configuration pre-defined security scheme for coex application.

source "Kconfig.zephyr"
```

## west.yml
```yaml
# The west manifest file (west.yml) for the NXP ZSDK
#
# The per-installation west configuration file, .west/config, sets the
# path to the project containing this file in the [manifest] section's
# "path" variable.
#
# You are free to create your own manifest files and put them in any
# repository you want, to create your own custom Zephyr installations.
# For example, you could create a manifest file in your own out of
# tree application directory, which would pull this zephyr repository
# in as an ordinary project.
#
# You can pass your manifest repositories to west init when creating a
# new Zephyr installation. See the west documentation for more
# information.
#
#     [manifest]
#     path = zsdk
#
manifest:
  version: "1.2"

  # "remotes" is a list of locations where git repositories are cloned
  # and fetched from.
  remotes:
    - name: nxp
      url-base: https://github.com/NXP
    - name: nxp-zsdk
      url-base: https://github.com/nxp-zephyr
    - name: nxp-mcuxpresso
      url-base: https://github.com/nxp-mcuxpresso
    - name: zephyrproject
      url-base: https://github.com/zephyrproject-rtos

  # If not otherwise specified, the projects below should be obtained
  # from the zsdk remote.
  defaults:
    remote: nxp-zsdk

  group-filter: [+optional, -bifrost]

  # "projects" is a list of git repositories to populate NXP Zephyr downstream
  # workspace.
  projects:

    - name: zephyr
      repo-path: nxp-zephyr
      revision: 6994fa11a6ee72c680258f14a886c5477a2d5e79
      import:
        #
        # ZSDK imports the contents of nxp-zephyr/west.yml at the above
        # revision. Only the projects explicitly named in the
        # following allowlist are imported.
        #
        # If there is an override of one of the Zephyr modules,
        # remove it from the name-allowlist and add the project
        # explicitly below the list.
        #
        name-allowlist:
          - TraceRecorderSource
          - canopennode
          - chre
          - cmsis
          - cmsis-dsp
          - cmsis-nn
          - cmsis_6
          - edtt
          - fatfs
          - hal_nxp
          - hal_st
          - hal_xtensa
          - liblc3
          - libmctp
          - libsbc
          - libmetal
          - littlefs
          - loramac-node
          - lvgl
          - lz4
          - mcuboot
          - mipi-sys-t
          - net-tools
          - open-amp
          - picolibc
          - segger
          - tinycrypt
          - uoscore-uedhoc
          - zcbor
          - zscilib
          - openthread
          - mbedtls
          - mldsa-native

    # For internal NXP development support
    - name: bifrost
      west-commands: scripts/west_commands.yml
      repo-path: bifrost
      revision: 7d8ee3d19939fa295610bc016b4e14835f5cbc7d
      groups:
        - bifrost

    #
    # NXP based overrides of Zephyr modules and additional
    # added modules
    #
    - name: hal_nxp
      revision: f5d0e60935cf7c75e31cd995e7de6585f79f4ec5
      path: modules/hal/nxp
      groups:
        - hal
    - name: els_pkc
      remote: nxp
      repo-path: els_pkc
      revision: c37a05831caf542ff240c3cb6a54da469d5e3c57
      path: modules/crypto/els_pkc
      groups:
        - crypto
    - name: sgi_pkc
      remote: nxp-mcuxpresso
      repo-path: sgi_pkc
      revision: 28d6f94ea75f602ed3847ed02e37874c70bcd743
      path: modules/crypto/sgi_pkc
      groups:
        - crypto
    - name: psa_crypto_driver
      remote: nxp
      repo-path: psa_crypto_driver
      revision: 54518163c46c5a63b00ea416f2660139e91d9841
      path: modules/crypto/psa_crypto_driver
      groups:
        - crypto
    - name: tf-psa-crypto
      remote: nxp-mcuxpresso
      repo-path: tf-psa-crypto
      revision: 71d47f726586413c2a7f7b6365e7883b8ec63429
      path: modules/crypto/tf-psa-crypto
      groups:
        - crypto
    - name: mbedtls-3.6
      remote: nxp
      repo-path: nxp_mbedtls
      revision: eeb4a0cae0e2d8157a6018f5a0170e2bdce49c88
      path: modules/crypto/mbedtls-3.6
      groups:
        - crypto
    - name: trusted-firmware-m
      remote: nxp
      repo-path: nxp_tf-m
      revision: 357d3b50a36db2e4bc8dffdabf00d43eb62a02a3
      path: modules/tee/tf-m/trusted-firmware-m
      groups:
        - tee
    - name: psa-arch-tests
      remote: nxp
      repo-path: nxp_psa_arch_test
      revision: 359b663e8a0196e434b4f67d59a9c99bc17ea895
      path: modules/tee/tf-m/psa-arch-tests
      groups:
        - tee
    - name: tf-m-tests
      revision: cde5b6ed540d3ff5a09564fded6b39b0a70ad3bf
      path: modules/tee/tf-m/tf-m-tests
      remote: zephyrproject
      groups:
        - tee
    - name: hostap
      repo-path: hostap
      revision: e8b4a95530ad507fbb41381912bcced88afb299c
      path: modules/lib/hostap
    - name: wifi_nxp
      remote: nxp
      repo-path: wifi_nxp
      revision: d9d47c7620c95213f446f914bf5afd9ed43af66e
      path: modules/hal/nxp/mcux/middleware/wifi_nxp
    - name: wifi_nb_fw
      remote: nxp
      repo-path: wifi_nb_fw
      revision: aaa5ae1e93f3a66c388ca86f0d362321b94d5b5e
      path: modules/hal/nxp/zephyr/blobs/
    - name: nxp_iot_agent
      remote: nxp
      repo-path: el2go-agent
      revision: 63d73cb591fd725ec408365cf0536dd978d5a6bf
      path: modules/lib/nxp_iot_agent
    - name: freemaster
      remote: nxp-mcuxpresso
      repo-path: mcux-freemaster
      revision: 52dd288482aab2a13b8c21926d0fe27ea32eb44d
      path: modules/debug/freemaster
    - name: freemaster-samples
      remote: nxp-zsdk
      repo-path: fmstr-zephyr-samples
      revision: 412487bedebc43c1fd40cb76d7d41f989c2f8063
      path: zsdk/samples/freemaster

    # Add any additional third-party repositories.

  self:
    path: zsdk
    # Configure west extensions.
    #west-commands: scripts/west-commands.yml
```
